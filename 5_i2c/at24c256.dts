/dts-v1/;
/plugin/;
/ {
    compatible = "brcm,bcm2708";
    fragment@0 {
        target = <&i2c1>;
        __overlay__ {
            pinctrl-names = "default";
            pinctrl-0 = <&i2c1_pins>;
            clock-frequency = <100000>;
            status = "okay";
            at24@50 {
                compatible = "atmel,24c256","microchip,24c256","at24";
                #address-cells = <1>;
                #size-cells = <0>;
                reg = <0x50>;
                pagesize = <64>;
                size = <32768>;
                address-width = <16>;
                vcc-supply = <&vdd_5v0_reg>;
            };
        };
    };
};
